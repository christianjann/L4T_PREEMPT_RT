/dts-v1/;

#include "tegra132-jetson-pm375-000-common.dtsi"

/ {
	nvidia,boardids = "375:0000:03";
	nvidia,dtsfilename = __FILE__;
	nvidia,proc-boardid = "375:0000:03";

	i2c@7000d000 {
		as3722@40 {
			ams,major-rev = <1>;
			ams,minor-rev = <2>;
		};
	};
};
